## s20-otbr/components/esp_ot_br_server/Kconfig
```kconfig
menu "OTA update check"

    config OTA_UPDATE_CHECK_REPO
        string "GitHub repository to check for firmware releases"
        default "scheeles/ep-s20-otbr"
        help
            Repository the device queries for new releases, as "owner/repo".

            This is only the factory default: it can be changed at runtime from the
            OTA page in the web UI, which stores it in NVS. Set it to whichever fork
            actually publishes the firmware these devices run — a device pointed at a
            repository someone else releases from will offer updates it should not.

endmenu
```

## s20-otbr/components/net_syslog/Kconfig
```kconfig
menu "Network syslog"

    config NET_SYSLOG_ENABLED
        bool "Mirror logs to a remote UDP syslog server"
        default n
        help
            Mirror the ESP-IDF log stream to a remote RFC3164 UDP syslog server
            (e.g. a Grafana Alloy loki.source.syslog listener). Purely additive:
            UART/console logging is unaffected.

            The server is normally set at runtime from the web UI (Network page)
            and stored in NVS; the options below only provide the defaults used
            when nothing is stored yet.

    config NET_SYSLOG_SERVER_IP
        string "Default syslog server IPv4 address"
        depends on NET_SYSLOG_ENABLED
        default ""
        help
            Fallback dotted-quad IPv4 address, used only when no server is
            stored in NVS. Leave empty to ship dormant and configure the
            server from the web UI. Hostnames are not resolved: remote
            logging must not depend on DNS being up.

    config NET_SYSLOG_SERVER_PORT
        int "Default syslog server UDP port"
        depends on NET_SYSLOG_ENABLED
        range 1 65535
        default 514

    config NET_SYSLOG_HOSTNAME
        string "Syslog HOSTNAME field"
        depends on NET_SYSLOG_ENABLED
        default "ep-s20-otbr"
        help
            Fallback value for the RFC3164 HOSTNAME field, used when no
            hostname is stored in NVS. Spaces are replaced with underscores.

endmenu
```

## s20-otbr/main/Kconfig.projbuild
```kconfig
menu "Firmware version Configuration"

    config SDK_VERSION
        string "SDK Version"
        default ""

    config SDK_URL
        string "SDK URL"
        default ""

    config SDK_HASH
        string "SDK Hash"
        default ""

    config SW_VERSION
        string "SW Version"
        default ""

endmenu

menu "Network syslog Configuration"

    config NET_SYSLOG_ENABLED
        bool "Mirror logs to a remote UDP syslog server"
        default n
        help
            Mirror the ESP-IDF log stream to a remote RFC3164 UDP syslog server
            (e.g. a Grafana Alloy loki.source.syslog listener). Purely additive:
            UART/console logging is unaffected. The socket is opened once the
            device has an IP address.

    config NET_SYSLOG_SERVER_IP
        string "Syslog server IPv4 address"
        depends on NET_SYSLOG_ENABLED
        default "192.168.1.10"
        help
            Dotted-quad IPv4 address of the syslog server. Hostnames are not
            resolved: remote logging must not depend on DNS being up.

    config NET_SYSLOG_SERVER_PORT
        int "Syslog server UDP port"
        depends on NET_SYSLOG_ENABLED
        range 1 65535
        default 514

    config NET_SYSLOG_HOSTNAME
        string "Syslog HOSTNAME field"
        depends on NET_SYSLOG_ENABLED
        default "ep-s20-otbr"
        help
            Fallback value for the RFC3164 HOSTNAME field, used when no hostname
            is stored in NVS. Spaces are replaced with underscores.

endmenu
```
